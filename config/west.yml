## config/west.yml
```yaml
manifest:
  defaults:
    revision: v0.3

  remotes:
    - name: zmkfirmware
      url-base: https://github.com
    - name: m165437 #new entry
      url-base: https://github.com #new entry

  projects:
    - name: zmk
      remote: zmkfirmware
      revision: main
      import: app/west.yml
    - name: nice-view-gem #new entry
      remote: m165437 #new entry
      revision: v0.3.0 #new entry

  self:
    path: config
```
